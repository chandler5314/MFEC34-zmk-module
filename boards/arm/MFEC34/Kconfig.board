## boards/arm/MFEC34/Kconfig.board
```kconfig
# MFEC34 board configuration

# Copyright (c) 2020 The ZMK Contributors
# SPDX-License-Identifier: MIT

config BOARD_MFEC34
    bool "MFEC34"
    select ZMK_KSCAN_EC_MATRIX_FAKE_OPEN_DRAIN
    imply ZMK_KSCAN_EC_MATRIX_DYNAMIC_POLL_RATE
#    imply SPI
    depends on SOC_NRF52840_QIAA
```

## boards/arm/MFEC34/Kconfig.defconfig
```kconfig
# Le Zapybara board configuration

# Copyright (c) 2020 The ZMK Contributors
# SPDX-License-Identifier: MIT

if BOARD_MFEC34

config BOARD
    default "MFEC34"

config ZMK_KEYBOARD_NAME
    default "MFEC34"




#config ZMK_SLEEP
#	select ZMK_ADXL362_AWAKE_TRIGGER_SLEEP
#	depends on ZMK_ADXL362_AWAKE_TRIGGER

if ZMK_BATTERY_REPORTING

choice ZMK_BATTERY_REPORTING_FETCH_MODE
	default ZMK_BATTERY_REPORTING_FETCH_MODE_LITHIUM_VOLTAGE
endchoice

endif

if USB

config USB_NRFX
	default y

config USB_DEVICE_STACK
	default y

endif # USB

config BT_CTLR
	default BT

endif # BOARD_MFEC34
```
